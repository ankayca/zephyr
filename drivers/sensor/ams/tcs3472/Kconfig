## drivers/sensor/ams/tcs3472/Kconfig
```kconfig
# Copyright 2023 Google LLC
# SPDX-License-Identifier: Apache-2.0

config TCS3472
	bool "TCS3472 Sensor"
	default y
	depends on DT_HAS_AMS_TCS3472_ENABLED
	select I2C
	help
	  Enable driver for TCS3472 sensors.
```
